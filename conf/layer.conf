## conf/layer.conf
```bitbake
# We have a conf and classes directory, add to BBPATH
BBPATH .= ":${LAYERDIR}"

# We have recipes-* directories, add to BBFILES
BBFILES += "\
    ${LAYERDIR}/recipes-*/*.bb \
    ${LAYERDIR}/recipes-*/*/*.bb \
    ${LAYERDIR}/recipes-*/*.bbappend \
    ${LAYERDIR}/recipes-*/*/*.bbappend \
    "

BBFILE_COLLECTIONS += "practice"
BBFILE_PATTERN_practice = "^${LAYERDIR}/"
BBFILE_PRIORITY_practice = "6"

LAYERDEPENDS_practice = "core"
# LAYERSERIES_COMPAT_practice = "kirkstone"
LAYERSERIES_COMPAT_practice = "${LAYERSERIES_COMPAT_core}"
```
